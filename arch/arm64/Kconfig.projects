## arch/arm64/Kconfig.projects
```kconfig
config SEC_MSM8917_PROJECT
  	depends on ARCH_MSM8917
        default n
        bool "Samsung MSM8917 Project"
        help
        Support for Samsung MSM8917 Project

config SEC_J4PRIMELTE_PROJECT
	depends on ARCH_MSM8937
	default n
	bool "Samsung J4PRIMELTE Project"
	help
	Support for Samsung J4PRIMELTE Project

config MACH_J4PRIMELTE_SEA_OPEN
	depends on SEC_J4PRIMELTE_PROJECT
	default n
	bool "Samsung J4PRIMELTE SEA OPEN"
	help
	Support for Samsung J4PRIMELTE SEA OPEN device.

config SEC_J6PRIMELTE_PROJECT
	depends on ARCH_MSM8937
	default n
	bool "Samsung J6PRIMELTE Project"
	help
	Support for Samsung J6PRIMELTE Project

config MACH_J6PRIMELTE_SWA_OPEN
	depends on SEC_J6PRIMELTE_PROJECT
	default n
	bool "Samsung J6PRIMELTE SWA OPEN"
	help
	Support for Samsung J6PRIMELTE SWA OPEN device.
```

## drivers/muic/Kconfig
```kconfig
#
# MUIC devices
#

comment "MUIC configs"

config USE_MUIC
	bool "Using MUIC device driver"
	depends on I2C
	default n
	help
	  If you say yes here you will get support for
	  the MUIC device driver.

config MUIC_VZW_ACC
	bool "Using Verizon Acc type"
	depends on USE_MUIC
	default n
	help
		If you say yes here you will get support for
		for the Verizon Acc type cable.

config MUIC_INCOMPATIBLE_VZW
	bool "Using Verizon incomatible type"
	depends on USE_MUIC
	default n
	help
		If you say yes here you will get support for
		for the Verizon incomatible type cable.

config USE_SAFEOUT
	bool "Using SAFEOUT device driver"
	depends on I2C
	default n
	help
	  If you say yes here you will get support for
	  the SAFEOUT device driver.

config MUIC_NOTIFIER
	bool "MUIC notifier support"
	depends on USE_MUIC
	default n
	help
	  If you say yes here you will get support for
	  the MUIC attached device status change notification.

config MUIC_DOCK_NOTIFIER
	bool "MUIC dock notifier support"
	depends on USE_MUIC
	default y
	help
	  If you say yes here you will get support for
	  the MUIC deskdock attached device status change notification.
	  additional drivers must be disable to stop notification.
	  
config MUIC_SUPPORT_EARJACK
	bool "MUIC earjack support"
	depends on USE_MUIC
	default n
	help
	  If you say yes here you will get support for
	  the EARJACK device.

config SAMSUNG_MUIC
	bool "Using samsung MUIC chip driver"
	depends on USE_MUIC
	default n
	help
	  If you say yes here you will get support for the MUIC chip.

config MUIC_ADCMODE_SWITCH_WA
	bool "Using MUIC chip ADC Mode change W/A"
	depends on USE_MUIC
	default n
	help
	  This feature is for MUIC chip's ADC Mode change
	  chip bug Workaround.

config MUIC_RUSTPROOF_ON_USER
	bool "Using MUIC chip Rustproof function ON for User binary"
	depends on USE_MUIC
	default n
	help
	  This feature is for MUIC chip's Rustproof function.

config S2MU005_SUPPORT_BC1P2_CERTI
	bool "S2MU005 Support BC 1.2 Certification"
	depends on USE_MUIC && MUIC_S2MU005
	default n
	help
	 Support for the BC 1.2 Certification.
	 This driver provides common support for accessing the device,
	 additional drivers must be enabled in order to use the functionality

config MUIC_S2MU005
	bool "Using S2MU005 MUIC"
	depends on USE_MUIC
	default n
	help
	  If you say yes here you will get support for
	  for the S2MU005 MUIC chip.
	 
config KEEP_JIG_LOW
	bool "Using KEEP JIG LOW"
	depends on MUIC_S2MU005
	default n
	help
	  If you say yes here you will get support for
	  keep jig signal low always for S22MU005 MUIC chip.

config SWITCH_DUAL_MODEM
        bool "SWITCH DUAL MODEM"
        default n
        help
          If you using separated chip AP and CP, Set Y.

config UART3
        bool "UART3"
        default n
        help
          If you say yes, you can use xo shutdown
config MUIC_SUPPORT_CCIC
	bool "MUIC supports CCIC chip interface"
	depends on USE_MUIC
	default n
	help
	  If you say yes here you will get support for the CCIC chip.

config MUIC_SUPPORT_RUSTPROOF
	bool "MUIC Disable UART"
	depends on !SEC_FACTORY
	default n
	help
	 This option will disable the UART to prevent the rusting of the
	 IF Connector in the case of Kmini Devices.

config MUIC_S2MU005_INNER_BATTERY
	bool "Setting inner battery W/A of S2MU005 MUIC driver"
	depends on USE_MUIC && MFD_S2MU005 && MUIC_S2MU005
	default n
	help
	  If you say yes here you will get support for
	  the INNER BATTERY for S2MU005 MUIC.
	  if device is inner battery type then please
	  say 'Y' here
	  
config MUIC_S2MU005_JIGB_CONTROL
	bool "Using S2MU005 MUIC JIGB CONTROL"
	depends on USE_MUIC && MUIC_S2MU005
	default n
	help
	  If you say yes here you will get support for
	  for the S2MU005 MUIC chip JIGB CONTROL feature.

config MUIC_S2MU005_ENABLE_AUTOSW
	bool "Using S2MU005 MUIC ENABLE AUTOSW"
	depends on USE_MUIC && MUIC_S2MU005
	default n
	help
	  If you say yes here you will get support for
	  for the S2MU005 MUIC chip ENABLE AUTOSW feature.
	  
config MUIC_S2MU005_DISCHARGING_WA
	bool "Using S2MU005 MUIC DISCHARGING WORKAROUND"
	depends on USE_MUIC && MUIC_S2MU005
	default n
	help
		If you say yes here you will get support for
		for the S2MU005 MUIC chip DISCHARGING WA feature.

config MUIC_S2MU005_WATER_WA_DISABLE
	bool "Using S2MU005 MUIC WATER WA DISABLE"
	depends on USE_MUIC && MUIC_S2MU005
	default n
	help
		If you say yes here you will get support for
		for the S2MU005 MUIC chip WATER WA DISABLE feature.

config MUIC_HV
	bool "MUIC_HV"
	depends on USE_MUIC
	default n
	help
	  If you say yes here you will get support for the AFC.

config HICCUP_CHARGER
	bool "Using HICCUP charger"
	depends on USE_MUIC && !SEC_FACTORY
	default n
	help
		If you say yes here you will get support for
		for the hiccup charger feature.

config MUIC_KEYBOARD
	bool "MUIC_KEYBOARD"
	depends on USE_MUIC
	default n
	help
	  If you say yes here you will get support for muic keyboard.

config GPIO_UART_SEL
	bool "GPIO_UART_SEL"
	depends on USE_MUIC
	default n
	help
	  If you say yes here you will get support for gpio setting for uart_sel.

config MUIC_S2MU005_SUPPORT_DESKDOCK
	bool "MUIC_S2MU005_SUPPORT_DESKDOCK"
	depends on USE_MUIC && MUIC_S2MU005
	default n
	help
	  If you say yes here you will get support for muic deskdock.

config MUIC_S2MU005_SUPPORT_WATERPROOF
	bool "MUIC_S2MU005_SUPPORT_WATERPROOF"
	depends on USE_MUIC && MUIC_S2MU005
	default n
	help
	  If you say yes here you will get support for muic waterproof functionality.
```

## drivers/sensors/Kconfig
```kconfig
config SENSORS_SSC
	bool "Enable Sensors Driver Support for SSC"
	help
	  Add support for sensors SSC driver.
	  This driver is used for exercising sensors use case,
	  time syncing with ADSP clock.

config SENSORS_CORE
    bool "Sensors Class Support"
    help
      This option enables the sensor sysfs class in /sys/class/sensors.
      You'll need this to do anything useful with sensorss. If unsure, say N.

config SENSORS_LIS2DS
	tristate "STMicroelectronics LIS2DS/LIS2DS12 sensors"
	depends on (I2C || SPI) && SYSFS
	help
	   This driver support the STMicroelectronics LIS2DS/LIS2DS12 sensors.
	   It is a accelerometer device.
	   To compile this driver as a module, choose M here. The module
	   will be called lis2ds.

config SENSORS_LIS2DS_I2C
	tristate "STMicroelectronics LIS2DS/LIS2DS12 sensors"
	depends on (I2C || SPI) && SYSFS
	help
	   This driver support the STMicroelectronics LIS2DS/LIS2DS12 sensors.
	   It is a accelerometer device.
	   To compile this driver as a module, choose M here. The module
	   will be called lis2ds.

config SENSORS_CM36686
	depends on I2C
	tristate "CM36686 driver"
	default n
	help
	  This option enables proximity & light sensors using CM36686 driver.

config SENSORS_STK3328
	depends on I2C
	tristate "STK3328 driver"
	default n
	help
	  This option enables proximity & light sensors using STK3328 driver.

config SENSORS_CM36686_LEDA_EN_GPIO
	depends on I2C
	tristate "CM36686 leda_en controlled by GPIO"
	default n
	help
	  This option enables leda_en controlled by GPIO using CM36686 driver.

config SENSORS_SW_RESET
	tristate "SENSOR SW RESET support"
	default n
	depends on I2C
	help
	  If you say yes here you get support for SENSOR SW RESET.

config SENSORS_YAS539
	tristate "YAS539 Sensor Driver"
	depends on I2C
	default n
	help
	  If you say yes here you get support for YAMAHA
	  YAS539 Geomagnitor Sensor.

config SENSORS_YAS_RESET_DEFENCE_CODE
	depends on I2C
	tristate "YAS defence code by reset"
	default n
	help
	  This option enables defence code by reset using yas driver.

config SENSORS_YAS539_DEFAULT_MATRIX
	depends on SENSORS_YAS539
	tristate "The default conpensation matrix for YAS539 softiron"
	default n
	help
	  This option is enables the default matrix for YAS539.

config SENSORS_GRIP_CHK_HALLIC
	depends on I2C
	tristate "grip sensor check to hallic"
	default n
	help
	 This option enables grip sensors checking hall ic status.

config SENSORS_LSM6DSL
	tristate "STMicroelectronics LSM6DSL sensor"
	depends on (I2C || SPI) && SYSFS
	default n
	help
	   This driver support the STMicroelectronics LSM6DSL sensor.
	   To compile this driver as a module, choose M here. The module
	   will be called lsm6dsl.

config SENSORS_LSM6DSL_I2C
	tristate "STMicroelectronics LSM6DSL sensor"
	depends on (I2C || SPI) && SYSFS
	default n
	help
	   This config define sensor communication type is I2C.

config SENSORS_LSM6DSL_SPI
	tristate "STMicroelectronics LSM6DSL sensor"
	depends on (I2C || SPI) && SYSFS
	default n
	help
	   This config define sensor communication type is SPI.
```
